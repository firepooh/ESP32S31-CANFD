## main/Kconfig.projbuild
```kconfig
menu "CAN-FD 2-Port Test Configuration"

    config CANFD_PORT1_TX_GPIO
        int "CAN1 TX GPIO"
        range 0 61
        default 35

    config CANFD_PORT1_RX_GPIO
        int "CAN1 RX GPIO"
        range 0 61
        default 36

    config CANFD_PORT2_TX_GPIO
        int "CAN2 TX GPIO"
        range 0 61
        default 37

    config CANFD_PORT2_RX_GPIO
        int "CAN2 RX GPIO"
        range 0 61
        default 38

    config CANFD_DEFAULT_NOMINAL_BITRATE
        int "Default nominal (arbitration) bitrate [bps]"
        default 500000

    config CANFD_DEFAULT_DATA_BITRATE
        int "Default data-phase bitrate [bps], 0 = classic CAN only"
        default 2000000

    config CANFD_DEFAULT_NOMINAL_SP_PERMILL
        int "Default nominal sample point [permill], 0 = driver default"
        range 0 999
        default 0

    config CANFD_DEFAULT_DATA_SP_PERMILL
        int "Default data-phase sample point [permill], 0 = driver default"
        range 0 999
        default 0

    config CANFD_DEFAULT_DATA_SSP_PERMILL
        int "Default data-phase secondary sample point [permill], 0 = disabled"
        range 0 999
        default 0
        help
            Secondary sample point offset (transmitter delay compensation).
            With 0 the hardware reset value stays active: measured delay + 10 clock cycles,
            which passed up to 8 Mbps on the test bench. Set it only to move the SSP explicitly.

    config CANFD_DEFAULT_AUTO_RECOVER_MS
        int "Default automatic bus-off recovery delay [ms], 0 = manual only"
        range 0 60000
        default 0
        help
            When a port goes bus-off, start the recovery sequence after this delay.
            0 disables automatic recovery; use the can_recover command instead.

    config CANFD_TX_QUEUE_DEPTH
        int "Driver TX queue depth per port"
        range 1 250
        default 64

    config CANFD_RX_QUEUE_DEPTH
        int "Application RX queue depth per port"
        range 8 8192
        default 1024

    config CANFD_QUEUE_IN_PSRAM
        bool "Place CAN RX/TX queue buffers and the TX frame pool in PSRAM"
        depends on SPIRAM
        default y
        help
            The ISR writes received frames into the RX queue buffer and the driver reads
            TX frames from the TX frame pool, so both are accessed from interrupt context.
            Only the data buffers move to PSRAM; the queue control blocks (which contain
            spinlocks) stay in internal RAM.

    config CANFD_AUTO_INIT
        bool "Initialize both ports with default settings at boot"
        default y

    menu "USB Candlelight adapter"

        config CANDLE_USB_ENABLE
            bool "Act as a Candlelight / ElmueSoft USB-CAN adapter on the HS OTG port"
            default y
            help
                Two-channel Candlelight (gs_usb) device with the ElmueSoft CANable 2.5
                extensions, compatible with cangaroo. While the host has a channel started,
                that CAN port is controlled by the host.

        config CANDLE_USB_PID
            hex "USB product ID (vendor ID is Espressif 0x303A)"
            depends on CANDLE_USB_ENABLE
            default 0x4C31
            help
                Test PID. Windows caches descriptors per VID/PID/bcdDevice.

        config CANDLE_HOST_FIFO_DEPTH
            int "Messages buffered per USB IN interface"
            depends on CANDLE_USB_ENABLE
            range 64 8192
            default 1024

    endmenu

endmenu
```
